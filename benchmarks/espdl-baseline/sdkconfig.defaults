## benchmarks/espnn-baseline/sdkconfig.defaults
```kconfig
CONFIG_ESP_DEFAULT_CPU_FREQ_MHZ_240=y
CONFIG_ESPTOOLPY_FLASHSIZE_8MB=y
CONFIG_PARTITION_TABLE_CUSTOM=y
CONFIG_PARTITION_TABLE_CUSTOM_FILENAME="partitions.csv"
CONFIG_ESP_WIFI_ENABLED=n
CONFIG_ESP_MAIN_TASK_STACK_SIZE=2048
CONFIG_COMPILER_OPTIMIZATION_SIZE=y

CONFIG_SPIRAM_IGNORE_NOTFOUND=y
```
